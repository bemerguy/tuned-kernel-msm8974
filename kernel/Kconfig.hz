## kernel/Kconfig.hz
```kconfig
#
# Timer Interrupt Frequency Configuration
#

config HZ
	int "Timer frequency (Hz)"

config SCHED_HRTICK
	def_bool HIGH_RES_TIMERS && (!SMP || USE_GENERIC_SMP_HELPERS)
```
